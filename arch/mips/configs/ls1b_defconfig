## drivers/net/stmmac/Kconfig
```kconfig
config STMMAC_ETH
	tristate "STMicroelectronics 10/100/1000 Ethernet driver"
	select MII
	select PHYLIB
	select CRC32
	depends on NETDEVICES && HAS_IOMEM
	help
	  This is the driver for the Ethernet IPs are built around a
	  Synopsys IP Core and only tested on the STMicroelectronics
	  platforms.

if STMMAC_ETH

config LS1X_GMAC0
	bool "Loongson1 GMAC0 support"
	default y
	depends on LS1A_MACH || LS1B_MACH || LS1C_MACH

choice
		prompt "ls1x gmac0 config"
		depends on LS1X_GMAC0

config LS1X_GMAC0_100M
		bool "100Mb MII mode"

config LS1X_GMAC0_1000M
		bool "1000Mb MII mode"

config LS1X_GMAC0_RMII
		bool "100Mb RMII mode"
		depends on LS1C_MACH
endchoice

config LS1X_GMAC1
	bool "Loongson1 GMAC1 support"
	default n
	depends on LS1A_MACH || LS1B_MACH

choice
		prompt "ls1x gmac1 config"
		depends on LS1X_GMAC1

config LS1X_GMAC1_100M
		bool "100Mb MII mode"

config LS1X_GMAC1_1000M
		bool "1000Mb MII mode"
endchoice

config RTL8305SC
	bool "STMMAC support RTL8305SC"
	default n
	help
	  Selecting this option, stmmac will support switch controller
	  rtl8305sc.

config STMMAC_DA
	bool "STMMAC DMA arbitration scheme"
	default n
	help
	  Selecting this option, rx has priority over Tx (only for Giga
	  Ethernet device).
	  By default, the DMA arbitration scheme is based on Round-robin
	  (rx:tx priority is 1:1).

config STMMAC_DUAL_MAC
	bool "STMMAC: dual mac support (EXPERIMENTAL)"
	default n
        depends on EXPERIMENTAL && STMMAC_ETH && !STMMAC_TIMER
	help
	  Some ST SoCs (for example the stx7141 and stx7200c2) have two
	  Ethernet Controllers. This option turns on the second Ethernet
	  device on this kind of platforms.

config STMMAC_TIMER
	bool "STMMAC Timer optimisation"
	default n
	depends on RTC_HCTOSYS_DEVICE
	help
	  Use an external timer for mitigating the number of network
	  interrupts. Currently, for SH architectures, it is possible
	  to use the TMU channel 2 and the SH-RTC device.

choice
        prompt "Select Timer device"
        depends on STMMAC_TIMER

config STMMAC_TMU_TIMER
        bool "TMU channel 2"
        depends on CPU_SH4
	help

config STMMAC_RTC_TIMER
        bool "Real time clock"
        depends on RTC_CLASS
	help

endchoice

endif
```

## drivers/net/wireless/rt3070_ls1b/Kconfig
```kconfig
config RT3070_LS1B
	tristate "loongson-1b of rt3070 Wireless module support"
	depends on MAC80211
	select CRC_CCITT
	select WIRELESS_EXT
	select WEXT_PRIV
```

## drivers/net/wireless/rtl8188etv/Kconfig
```kconfig
config RTL8188EU
	tristate "Realtek 8188E/8188ETV USB WiFi"
	depends on USB
	select CRC_CCITT
	select WIRELESS_EXT
	select WEXT_SPY
	select WEXT_PRIV
	---help---
	  Help message of RTL8188EU
```

## drivers/net/wireless/wm8782/Kconfig
```kconfig
config WM8782_LS1X
	tristate "loongson-1x of WM8782 Wireless module support"
	depends on MAC80211
	select CRC_CCITT
	select WIRELESS_EXT
	select WEXT_PRIV
	select WEXT_SPY
```

## sound/mips/Kconfig
```kconfig
# ALSA MIPS drivers

menuconfig SND_MIPS
	bool "MIPS sound devices"
	depends on MIPS
	default y
	help
	  Support for sound devices of MIPS architectures.

if SND_MIPS

config SND_SGI_O2
	tristate "SGI O2 Audio"
	depends on SGI_IP32
        help
                Sound support for the SGI O2 Workstation. 

config SND_SGI_HAL2
        tristate "SGI HAL2 Audio"
        depends on SGI_HAS_HAL2
        help
                Sound support for the SGI Indy and Indigo2 Workstation.


config SND_AU1X00
	tristate "Au1x00 AC97 Port Driver"
	depends on SOC_AU1000 || SOC_AU1100 || SOC_AU1500
	select SND_PCM
	select SND_AC97_CODEC
	help
	  ALSA Sound driver for the Au1x00's AC97 port.

config SND_LS1X_LIB
	tristate
	select SND_AC97_CODEC if SND_LS1A_LIB_AC97

config SND_LS1A_LIB_AC97
	bool

config SND_LS1A_AC97
	tristate "AC97 driver for the SB2F chip"
	depends on MACH_LOONGSON_SB2F
	select SND_LS1A_PCM
	select SND_AC97_CODEC
	select SND_LS1A_LIB
	select SND_LS1A_LIB_AC97
	help
	 Say Y or M if you want to support any AC97 codec attached to
	 the LS1A AC97 interface.

endif	# SND_MIPS
```

## sound/soc/loongson1/Kconfig
```kconfig
config SND_LS1X_SOC
	tristate "SoC Audio for the Loongson1 chip"
	depends on LS1C_MACH
	select SND_MIPS
	select SND_LS1X_LIB
	help
	  Say Y or M if you want to add support for codecs attached to
	  the Loongson1 AC97, I2S interface. You will also need
	  to select the audio interfaces to support below.

config SND_LS1X_SOC_I2S
	tristate

config SND_LS1X
	tristate "SoC IIS Audio support for Loongson1 chip"
	depends on LS1C_MACH
	select SND_LS1X_SOC_I2S
	help
	  Say Y if you want to add support for SoC audio on the
	  Loongson 1A chip.
```
